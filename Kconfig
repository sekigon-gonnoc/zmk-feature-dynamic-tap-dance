## Kconfig
```kconfig
# SPDX-License-Identifier: MIT

config ZMK_DYNAMIC_TAP_DANCE
	bool "Nemu-link runtime tap dance behaviors"
	depends on ZMK_STUDIO_RPC
	depends on ZMK_DYNAMIC_SETTINGS
	depends on ZMK_BEHAVIOR_LOCAL_IDS
	default y
	help
	  Enable shared, Settings-backed dynamic tap dance slots.

config ZMK_DYNAMIC_TAP_DANCE_MAX_SLOTS
	int "Maximum runtime tap dance slots"
	depends on ZMK_DYNAMIC_TAP_DANCE
	range 1 32
	default 4
	help
	  Maximum number of generated Settings record groups and tap dance dispatchers. The schema
	  generator creates empty record groups when fewer behavior nodes are declared.

config ZMK_DYNAMIC_TAP_DANCE_MAX_ACTIVE
	int "Maximum simultaneous runtime tap dances"
	depends on ZMK_DYNAMIC_TAP_DANCE
	range 1 4
	default 2
```

## dts/bindings/behaviors/sekigon,dynamic-behavior-tap-dance.yaml
```yaml
# SPDX-License-Identifier: MIT

description: Runtime Tap Dance dispatcher backed by an Nemu-link settings record
compatible: "sekigon,dynamic-behavior-tap-dance"
include: zero_param.yaml
properties:
  slot-index:
    type: int
    required: true
  target-role:
    type: string
    description: Settings owner role for this shared tap dance record.
  default-term-ms:
    type: int
    description: Initial tapping term when at least one default output is configured.
  default-tap:
    type: phandle-array
    specifier-space: binding
    description: Initial single-tap output Behavior binding.
  default-hold:
    type: phandle-array
    specifier-space: binding
    description: Initial hold output Behavior binding.
  default-double-tap:
    type: phandle-array
    specifier-space: binding
    description: Initial double-tap output Behavior binding.
  default-tap-hold:
    type: phandle-array
    specifier-space: binding
    description: Initial tap-then-hold output Behavior binding.
```
